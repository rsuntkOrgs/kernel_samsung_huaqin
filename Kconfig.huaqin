## Kconfig.huaqin
```kconfig
menu "Huaqin Project Option"
config HQ_PROJECT_HS03S
	bool CONFIG_HQ_PROJECT_HS03S
	default n
	help
	HQ PROJECT HS03S

config HQ_PROJECT_OT8
   bool CONFIG_HQ_PROJECT_OT8
   default n
   help
   HQ PROJECT OT8

config HQ_PROJECT_HS04
   bool CONFIG_HQ_PROJECT_HS04
   default n
   help
   HQ PROJECT HS04

config HQ_PROJECT_O22
   bool CONFIG_HQ_PROJECT_O22
   default n
   help
   HQ PROJECT O22

config HQ_PROJECT_O8
   bool CONFIG_HQ_PROJECT_O8
   default n
   help
   HQ PROJECT A06

endmenu
```
